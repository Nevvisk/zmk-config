## config/west.yml
```yaml
manifest:
  remotes:
    - name: zmkfirmware
      url-base: https://github.com/zmkfirmware
    - name: zmk-locales
      url-base: https://github.com/joelspadin
  projects:
    - name: zmk
      remote: zmkfirmware
      revision: main
      import: app/west.yml
    - name: zmk-locales
      remote: zmk-locales
      revision: main # Or a specific commit hash/tag for stability
      # The import property ensures any dependencies within the locale repo are also fetched
      import: app/west.yml
  self:
    path: config
```
